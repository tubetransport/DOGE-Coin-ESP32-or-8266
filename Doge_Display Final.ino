#include <Arduino.h>
#include <ArduinoJson.h>
#include <Wire.h>                  
#include <Adafruit_GFX.h>           
#include <Adafruit_SSD1306.h>  

// use this section for  ESP8266 or node MCU 
#include <ESP8266WiFi.h>            
#include <ESP8266HTTPClient.h> 
#include <ESP8266WiFiMulti.h> 
//end of ESP8266 section



#include <WiFiClientSecureBearSSL.h> //ssh Client 
#include "certs.h" //ssh certificte-  needed for HTTPS will ignore later

//Define SD1306 Screen Parameters
#define SCREEN_WIDTH 128            
#define SCREEN_HEIGHT 64             
#define OLED_RESET    -1             // Reset pin not used
#define OLED_ADDR      0x3C          // I2C address of the Adafruit SD1306 OLED display
Adafruit_SSD1306 display(SCREEN_WIDTH, SCREEN_HEIGHT, &Wire, OLED_RESET);

// Replace with your network credentials
const char* ssid = "YOUR_SSID_";
const char* password = "YOUR_PAASWORD";

// Dogecoin price API endpoint
const char* coinPriceURL = "https://api.coingecko.com/api/v3/simple/price?ids=dogecoin&vs_currencies=usd";

//DOGE Spashscreen 128x64
const uint8_t bmpImage[] PROGMEM = {

 0x00, 0x00, 0x00, 0x00, 0x00, 0x00, 0x00, 0x1f, 0xfc, 0x00, 0x00, 0x00, 0x00, 0x00, 0x00, 0x00, 
	0x00, 0x00, 0x00, 0x00, 0x00, 0x00, 0x03, 0xff, 0xff, 0xc0, 0x00, 0x00, 0x00, 0x00, 0x00, 0x00, 
	0x00, 0x00, 0x00, 0x00, 0x00, 0x00, 0x0f, 0xff, 0xff, 0xf0, 0x00, 0x00, 0x00, 0x00, 0x00, 0x00, 
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	0x00, 0x00, 0x00, 0x00, 0x00, 0x00, 0x00, 0x3f, 0xfc, 0x00, 0x00, 0x00, 0x00, 0x00, 0x00, 0x00
};


void setup() {
  // Initialize serial communication
  Serial.begin(9600);

  // Initialize the OLED display
  if(!display.begin(SSD1306_SWITCHCAPVCC, OLED_ADDR)) {
    Serial.println(F("SSD1306 allocation failed"));
    for(;;);
  }

  // Show the DOGE splash screen.
  display.clearDisplay();
  display.drawBitmap(0, 0, bmpImage, 128, 64, WHITE);  // Adjust dimensions if needed
  
  display.display();
  delay(2000); // Pause for 2 seconds

  // Clear the buffer
  display.clearDisplay();
  
  // Connect to Wi-Fi
  WiFi.begin(ssid, password);
  Serial.print("Connecting to ");
  Serial.print(ssid);

  while (WiFi.status() != WL_CONNECTED) {
    delay(500);
    Serial.print(".");
  }
  Serial.println(" connected");



  // Fetch and display Dogecoin price
  fetchAndDisplayPrice();
}

void loop() {
  // Update every minute
  delay(60000);
  fetchAndDisplayPrice();
}



void fetchAndDisplayPrice() {
std::unique_ptr<BearSSL::WiFiClientSecure> client(new BearSSL::WiFiClientSecure);

  client->setInsecure();
  HTTPClient https;
  https.begin(*client, coinPriceURL);

  int httpCode = https.GET();
  if (httpCode > 0) {
    String payload = https.getString();
       Serial.println(payload);
  
  


 // Create a DynamicJsonDocument object
DynamicJsonDocument doc(1024);  

//Deserialize the JSON document
DeserializationError error = deserializeJson(doc, payload);
 //Test if parsing succeeds.
  if (error) {
    Serial.print(F("deserializeJson() failed: "));
    Serial.println(error.f_str());
    return;
  }
 // Extract the Dogecoin price
float price = doc["dogecoin"]["usd"];

Serial.println(price, 6);

 //DOGE thumbnail
static const unsigned char PROGMEM DOGE_Thumbnail[] =
{
  0x00, 0x0f, 0xf0, 0x00, 0x00, 0x7f, 0xfe, 0x00, 0x01, 0xff, 0xff, 0x80, 0x03, 0xff, 0xff, 0xc0, 
	0x07, 0xff, 0xff, 0xe0, 0x0f, 0xff, 0xff, 0xf0, 0x1f, 0xff, 0xff, 0xf8, 0x3f, 0xe0, 0x3f, 0xfc, 
	0x3f, 0xe0, 0x07, 0xfc, 0x7f, 0xe0, 0x03, 0xfe, 0x7f, 0xe0, 0x01, 0xfe, 0x7f, 0xe3, 0xe0, 0xfe, 
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	0x03, 0xff, 0xff, 0xc0, 0x01, 0xff, 0xff, 0x80, 0x00, 0x7f, 0xfe, 0x00, 0x00, 0x0f, 0xf0, 0x00
};

  //Display the price on the OLED
  display.clearDisplay();
  display.drawBitmap(0, 0, DOGE_Thumbnail, 32, 32, WHITE);
  display.setTextSize(3);
  display.setTextColor(SSD1306_WHITE);
  display.setCursor(38, 7);
  display.print("DOGE");
  display.setTextSize(2);
  display.setCursor(0, 40);
  display.print("$");
  display.print(price, 6);
  display.display();
  }}

  





